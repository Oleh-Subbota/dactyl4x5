## config/boards/shields/dactyl5x5/Kconfig.shield
```kconfig
config SHIELD_DACTYL5X5_LEFT
    def_bool $(shields_list_contains,dactyl5x5_left)

config SHIELD_DACTYL5X5_RIGHT
    def_bool $(shields_list_contains,dactyl5x5_right)
```
